## config/west.yml
```yaml
manifest:
  remotes:
    - name: zmkfirmware
      url-base: https://github.com/zmkfirmware
    - name: caksoylar
      url-base: https://github.com/caksoylar
    - name: mouse
      url-base: https://github.com/ftc/
  projects:
    - name: zmk
      remote: mouse
      revision: mouse-ftc
      import: app/west.yml
  self:
    path: config
```
